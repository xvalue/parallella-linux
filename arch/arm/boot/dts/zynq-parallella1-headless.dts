/dts-v1/;

/ {
	/*option1: full console, has been know to get stuck sometimes with screen connected*/
	/*option2: without console */
	/*option3: use root file system on usb connected disk */
	chosen {
		bootargs = "root=/dev/mmcblk0p2 rw earlyprintk rootfstype=ext4 rootwait";
		//1. bootargs = "console=ttyPS0,115200 root=/dev/mmcblk0p2 rw earlyprintk rootfstype=ext4 rootwait";
		//2. bootargs = "root=/dev/mmcblk0p2 rw earlyprintk rootfstype=ext4 rootwait";
		//3. bootargs = "console=ttyPS0,115200 root=/dev/sda1 rw earlyprintk rootfstype=ext4 rootwait";
		linux,stdout-path = "/amba@0/serial@e0001000";
	};
};

/include/ "zynq-parallella1.dtsi"
